## drivers/gpu/rogue/Kconfig
```kconfig
# SPDX-License-Identifier: GPL-2.0
config MITOCHODRIA_ROC1_PVR
	bool "ROC1 PowerVR Rogue 1.11@5516664"
	depends on ARM64 && ARCH_SPRD && DRM=y && ION=y && ION_SPRD=y
	depends on PM_DEVFREQ && DEVFREQ_GOV_SIMPLE_ONDEMAND
	select SYNC_FILE
	select MITOCHODRIA_PVR_CACHE_API
	default n
	help
	  Native ROC1 Rogue driver using the JingPad/C8Pro BSP DDK and its
	  existing userspace bridge protocol. Built in so the factory vendor
	  filesystem need not be changed to replace its 4.14 module.
```

## drivers/iio/sprd_hub/Kconfig
```kconfig
#
# SPRD Sensor Hub drivers configuration
#

menu "Spreadtrum Sensor Hub"

config SPRD_SENSOR_HUB
	tristate "Spreadtrum Sensor Hub"
	select IIO_BUFFER
	select IIO_KFIFO_BUF
	select IIO_TRIGGER
	depends on SPRD_SYSTIMER
	depends on UNISOC_SIPC
	help
	  Support Sensor hub Feature
	  Provide power saving solution for integrating and
	  processing sensor data.

	  Say Y here to build support for sensor hub.
	  To compile this driver as a module, choose M here

config MITOCHODRIA_SENSOR_HUB_LEGACY
	bool "Mitochodria legacy Android 9 SensorHub protocol"
	depends on SPRD_SENSOR_HUB
	help
	  Restore the opcode download and tagged event ABI used by the
	  legacy CM4 firmware and Android 9 sensor HAL.

config MITOCHODRIA_CM4_LOADER
	bool "Mitochodria ROC1 CM4 userspace loader interface"
	depends on ARCH_SPRD && OF && PROC_FS && MFD_SYSCON
	help
	  Expose DT-described CM4 memory segments to the userspace Trusty
	  firmware loader. Firmware authentication remains owned by the TEE.

endmenu
```

## drivers/misc/sprd_vsp/Kconfig
```kconfig
# to add sprd vsp configs in the future
config SPRD_VSP
	tristate "SPRD vsp driver"
	depends on ARCH_SPRD && ION_SPRD && UNISOC_IOMMU

config SPRD_VSP_PW_DOMAIN
	bool "SPRD vsp power domain"
	depends on SPRD_VSP
	help
	say Y if in whale series chip; otherwise, N.
	this is to power on vsp domain.

config SPRD_VSP_CALL_CAM_PW_DOMAIN
	bool "SPRD VSP call camera power domain"
	depends on SPRD_VSP
	help
	say Y if in R6P0 chip, such as PIKE2; otherwise, N.
	this is to power on vsp which calls the interface implemented by camera domain.
```

## drivers/unisoc_platform/hang_debug/Kconfig
```kconfig
config SPRD_HANG_DEBUG
	bool "Enable SPRD hang debug feature"
	default n
	help
	  This option enables SPRD hang debug feature which dump and
	  print debug info when kernel panics.

config SPRD_APHANG
	tristate "Enable SPRD hang debug wdf wdh feature"
	depends on SPRD_HANG_DEBUG
	help
	  This option combines two ko, wdh and wdf,
	  in order to reduce the number of ko and
	  ensures that the original function
	  is not lost.

config SPRD_WDF
	tristate "SPRD hang debug WDF (watchdog feed) only"
	depends on SPRD_HANG_DEBUG

config SPRD_WDH
	tristate "SPRD hang debug WDH (watchdog hang) only"
	depends on SPRD_HANG_DEBUG
	help
	  Build only the WDF (watchdog feed) part as its own module,
	  matching the 4.14 factory configuration.

config SPRD_HANG_RESET
	bool "trigger cm4 handling ap watchdog reset"
	depends on SPRD_APHANG
	default y

config SPRD_HANG_TRIGGER
	bool "supply a driver for trigger AP cpu hang"
	depends on SPRD_HANG_DEBUG
	help
	  This option triggers SPRD cpu hang.

config SPRD_WDF_FEED_TIME_MS
	int "modify feed watchdog time ms"
	depends on SPRD_HANG_DEBUG
	default 8000
	help
	  This option enables modify feed watchdog interval config.

config SPRD_WDT_TIMEOUT_MS
	int "modify watchdog timeout ms"
	depends on SPRD_HANG_DEBUG
	default 40000
	help
	  This option enables modify watchdog timeout.

config SPRD_WDT_PRETIMEOUT_MS
	int "modify pertimeout ms"
	depends on SPRD_HANG_DEBUG
	default 20000
	help
	  This option enables modify watchdog pretimeout.
```

## sound/soc/codecs/aw8898/Kconfig
```kconfig
config SND_SOC_AW8898
	tristate "Awinic AW8898 SmartPA"
	depends on I2C
	help
	  Enable support for the Awinic AW8898 Smart Power Amplifier.
	  Used on iflytek iclass-c8pro (UD710 ROC1).
```

## sound/soc/sprd/roc1/dai/vbc/Kconfig
```kconfig
menu "SPRD VBC Dai Version"
source "sound/soc/sprd/roc1/dai/vbc/v4/Kconfig"
source "sound/soc/sprd/roc1/dai/vbc/r1p0v3/Kconfig"
endmenu
```

## sound/soc/sprd/roc1/dai/vbc/v4/Kconfig
```kconfig
config SND_SOC_SPRD_VBC_V4
	tristate "VBC V4"
	depends on SPRD_AUDIO_MCDT && SPRD_AUDIO_SIPC
	help
	  If the chip is the series of sharkl5,
	  set Y or M, else N.

config MITOCHODRIA_VBC_LEGACY_ABI
	bool "Mitochodria legacy Android 9 audio DSP protocol"
	depends on SND_SOC_SPRD_VBC_V4
	help
	  Use the 616-byte startup/shutdown layout and unshifted DMIC
	  selection expected by the legacy 4.14.98 audio firmware.
	  Select this only when using that firmware and its Android 9 HAL.
	  Other boards retain the newer VBC startup protocol by default.
```

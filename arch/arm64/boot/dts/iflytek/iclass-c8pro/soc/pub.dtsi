/*
 * iclass-c8pro hardware description; included in place from the board DTS.
 * Copyright (C) 2026 Evarentha - Linux 5.15 board port changes.
 */

		pub {
			compatible = "simple-bus";
			#address-cells = <0x02>;
			#size-cells = <0x02>;
			ranges;

			dmc_mpu: dmc-mpu@31030000 {
				compatible = "sprd,roc1-dmc-mpu";
				reg = <0x00 0x31030000 0x00 0x10000>;
				interrupts = <0x00 0x6f 0x04>;
				syscon-names = "irq_clr", "irq_en";
				syscons = <0x8e 0x32f0 0x200 0x8e 0x32f0 0x100>;
				sprd,channel-num = <0x08>;
				sprd,mpu-num = <0x10>;
				sprd,channel-names = "CPU", "GPU", "DPU/DCAM", "ISP/VDSP", "AP/VSP/AON/eSE/IPA-1", "WTLCP", "PUBCP/AUDCP/IPA-2", "AI", "SHARED0", "SHARED1", "SHARED2", "SHARED3", "SHARED4", "SHARED5", "SHARED6", "SHARED7";
				sprd,ranges = <0x00 0x00 0x00 0x00 0x00 0x00 0x00 0x00 0x00 0x00 0x00 0x00 0x00 0x00 0x00 0x00 0x00 0x00 0x00 0x00 0x00 0x00 0x00 0x00 0x00 0x00 0x00 0x00 0x00 0x00 0x00 0x00 0x00 0x00 0x00 0x00 0x00 0x00 0x00 0x00 0x00 0x00 0x00 0x00 0x00 0x00 0x00 0x00 0x00 0x00 0x00 0x00 0x00 0x00 0x00 0x00 0x00 0x00 0x00 0x00 0x00 0x00 0x00 0x00>;
				sprd,chn-config = <0x00 0x01 0x01 0x00 0x01 0x01 0x00 0x01 0x01 0x00 0x01 0x01 0x00 0x01 0x01 0x00 0x01 0x01 0x00 0x01 0x01 0x00 0x01 0x01 0x00 0x01 0x01 0x00 0x01 0x01 0x00 0x01 0x01 0x00 0x01 0x01 0x00 0x01 0x01 0x00 0x01 0x01 0x00 0x01 0x01 0x00 0x01 0x01>;
				sprd,id-config = <0x00 0x00 0xffff 0x00 0x00 0xffff 0x00 0x00 0xffff 0x00 0x00 0xffff 0x00 0x00 0xffff 0x00 0x00 0xffff 0x00 0x00 0xffff 0x00 0x00 0xffff 0x00 0x00 0xffff 0x00 0x00 0xffff 0x00 0x00 0xffff 0x00 0x00 0xffff 0x00 0x00 0xffff 0x00 0x00 0xffff 0x00 0x00 0xffff 0x00 0x00 0xffff>;
				sprd,port-map = <0x00 0x01 0x02 0x03 0x04 0x05 0x06 0x07 0x00 0x00 0x00 0x00 0x00 0x00 0x00 0x00>;
				sprd,ddr-offset = <0x80000000>;
				status = "okay";
				phandle = <0x184>;
			};

			dmc_controller: dmc-controller@31050000 {
				compatible = "sprd,roc1-dmc";
				reg = <0x00 0x31050000 0x00 0x7000 0x00 0x3000 0x00 0x1000>;
				phandle = <0x185>;
			};

			ptm_trace: ptm@31060000 {
				compatible = "sprd,roc1-ptm";
				reg = <0x00 0x31060000 0x00 0x10000 0x00 0x3c002000 0x00 0x1000 0x00 0x3c003000 0x00 0x1000 0x00 0x3c006000 0x00 0x1000>;
				interrupts = <0x00 0x6d 0x04>;
				clock-names = "clk_cs", "cs_src";
				clocks = <0x7b 0x24 0x07 0x0f>;
				sprd,funnel-port = <0x03>;
				sprd,ddr-chn = <0x08>;
				sprd,chn-name = "CPU", "GPU", "DPU/DCAM", "ISP/VDSP", "AP/VSP/AON/eSE/IPA1", "WTLCP", "PUBCP/AUDCP/IPA2", "AI";
				phandle = <0x186>;
			};
		};


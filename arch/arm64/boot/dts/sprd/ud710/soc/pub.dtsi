/*
 * Spreadtrum Roc1 platform DTS file
 *
 * Copyright (C) 2018, Spreadtrum Communications Inc.
 *
 * This file is licensed under a dual GPLv2 or X11 license.
 */

		pub {
			compatible = "simple-bus";
			#address-cells = <2>;
			#size-cells = <2>;
			ranges;

			dmc_mpu: dmc-mpu@31030000 {
				compatible = "sprd,roc1-dmc-mpu";
				reg = <0 0x31030000 0 0x10000>;
				interrupts = <GIC_SPI 111 IRQ_TYPE_LEVEL_HIGH>;
				syscon-names = "irq_clr", "irq_en";
				syscons = <&pub_apb_regs
					REG_PUB_APB_PUB_INT_CTRL
					MASK_PUB_APB_DMC_MPU_VIO_INT_CLR>,
					<&pub_apb_regs
					REG_PUB_APB_PUB_INT_CTRL
					MASK_PUB_APB_DMC_MPU_VIO_INT_EN>;
				sprd,channel-num = <8>;
				sprd,mpu-num = <16>;
				sprd,channel-names =
					"CPU", "GPU", "DPU/DCAM","ISP/VDSP",
					"AP/VSP/AON/eSE/IPA-1", "WTLCP",
					"PUBCP/AUDCP/IPA-2","AI",
					"SHARED0", "SHARED1", "SHARED2",
					"SHARED3", "SHARED4", "SHARED5",
					"SHARED6", "SHARED7";
				sprd,ranges = <0 0 0 0>, <0 0 0 0>, <0 0 0 0>,
					<0 0 0 0>, <0 0 0 0>, <0 0 0 0>,
					<0 0 0 0>, <0 0 0 0>, <0 0 0 0>,
					<0 0 0 0>, <0 0 0 0>, <0 0 0 0>,
					<0 0 0 0>, <0 0 0 0>, <0 0 0 0>,
					<0 0 0 0>;
				sprd,chn-config =
					<DISABLE MON_INSIDE MON_WRITE>,
					<DISABLE MON_INSIDE MON_WRITE>,
					<DISABLE MON_INSIDE MON_WRITE>,
					<DISABLE MON_INSIDE MON_WRITE>,
					<DISABLE MON_INSIDE MON_WRITE>,
					<DISABLE MON_INSIDE MON_WRITE>,
					<DISABLE MON_INSIDE MON_WRITE>,
					<DISABLE MON_INSIDE MON_WRITE>,
					<DISABLE MON_INSIDE MON_WRITE>,
					<DISABLE MON_INSIDE MON_WRITE>,
					<DISABLE MON_INSIDE MON_WRITE>,
					<DISABLE MON_INSIDE MON_WRITE>,
					<DISABLE MON_INSIDE MON_WRITE>,
					<DISABLE MON_INSIDE MON_WRITE>,
					<DISABLE MON_INSIDE MON_WRITE>,
					<DISABLE MON_INSIDE MON_WRITE>;
				sprd,id-config =
					<MPUID 0 0xffff>, <MPUID 0 0xffff>,
					<MPUID 0 0xffff>, <MPUID 0 0xffff>,
					<MPUID 0 0xffff>, <MPUID 0 0xffff>,
					<MPUID 0 0xffff>, <MPUID 0 0xffff>,
					<MPUID 0 0xffff>, <MPUID 0 0xffff>,
					<MPUID 0 0xffff>, <MPUID 0 0xffff>,
					<MPUID 0 0xffff>, <MPUID 0 0xffff>,
					<MPUID 0 0xffff>, <MPUID 0 0xffff>;
				sprd,port-map = <0>, <1>, <2>, <3>, <4>,
						<5>, <6>, <7>, <0>, <0>,
						<0>, <0>, <0>, <0>, <0>,
						<0>;
				sprd,ddr-offset = <0x80000000>;
				status = "disabled";
			};

			dmc_controller: dmc-controller@31050000  {
				compatible = "sprd,roc1-dmc";
				reg = <0x0 0x31050000 0x0 0x7000>,
					<0x0 0x3000 0x0 0x1000>;
			};

			ptm_trace: ptm@31060000 {
				compatible = "sprd,roc1-ptm";
				reg = <0x0 0x31060000 0x0 0x10000>,
					<0x0 0x3c002000 0x0 0x1000>,
					<0x0 0x3c003000 0x0 0x1000>,
					<0x0 0x3c006000 0x0 0x1000>;
				interrupts = <GIC_SPI 109 IRQ_TYPE_LEVEL_HIGH>;
				clock-names = "clk_cs","cs_src";
				clocks = <&aon_clk CLK_CSSYS>,
					<&g12_pll CLK_TWPLL_153M6>;
				sprd,funnel-port = <3>;
				sprd,ddr-chn = <8>;
				sprd,chn-name = "CPU", "GPU", "DPU/DCAM",
					"ISP/VDSP", "AP/VSP/AON/eSE/IPA1",
					"WTLCP","PUBCP/AUDCP/IPA2","AI";
			};
		};


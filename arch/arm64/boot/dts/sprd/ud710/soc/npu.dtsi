/*
 * Spreadtrum Roc1 platform DTS file
 *
 * Copyright (C) 2018, Spreadtrum Communications Inc.
 *
 * This file is licensed under a dual GPLv2 or X11 license.
 */

		ai-axi {
			compatible = "simple-bus";
			#address-cells = <2>;
			#size-cells = <2>;
			ranges;

			ipu0: ipu@6fc00000 {
				compatible = "img,ax21xx-nna";
				reg = <0 0x6fc00000 0 0x10000>;
				interrupts = <GIC_SPI 132 IRQ_TYPE_LEVEL_HIGH>;
				interrupt-names = "ai_powervr";
				sprd,pd-ai = <&pd_ai_powervr>,
					<&pd_ai_cambricon>;
				syscon-names = "reset";
				syscons = <&ai_apb_regs REG_AI_APB_APB_RST
					MASK_AI_APB_POWERVR_SOFT_RST>;
				sprd,qos = <&ai_qos>;
				clock-names = "top_eb",
					"pvr_eb",
					"pvr_clk",
					"pvr_clk_512m",
					"pvr_clk_apll",
					"mtx_clk";
				clocks = <&ai_gate CLK_AI_TOP_APB_EB>,
					<&ai_gate CLK_AI_POWERVR_EB>,
					<&ai_clk CLK_POWERVR>,
					<&g12_pll CLK_TWPLL_512M>,
					<&g12_pll CLK_APLL>,
					<&ai_clk CLK_AI_MTX>;
			};

			ipu1: ipu@6fe00000 {
				compatible = "cambricon,1h16-ipu";
				reg = <0 0x6fd08000 0 0x80>,
					<0 0x6fe00000 0 0x1000>,
					<0 0x6fe40000 0 0x1000>,
					<0 0x6ff00000 0 0x1000>;
				reg-names = "ai_iommu", "ipu_regs",
					"ipu_timer", "boot_iram";
				interrupts = <GIC_SPI 133 IRQ_TYPE_LEVEL_HIGH>,
					<GIC_SPI 134 IRQ_TYPE_LEVEL_HIGH>;
				interrupt-names = "ai_cambricon", "ai_mmu";
				iommus = <&iommu_ai>;
				sprd,pd-ai = <&pd_ai_cambricon>,
					<&pd_ai_powervr>;
				syscon-names = "reset";
				syscons = <&ai_apb_regs
					REG_AI_APB_AI_CAMBRICON_SOFT_RST
					MASK_AI_APB_CAMB_SOFT_RST>;
				sprd,qos = <&ai_qos>;
				clock-names = "top_eb",
					"mmu_eb",
					"cmbn_eb",
					"ai_mtx_clk",
					"cmbn_clk",
					"clk_src_512m",
					"clk_scr_768m",
					"clk_src_apll";
				clocks = <&ai_gate CLK_AI_TOP_APB_EB>,
					<&ai_gate CLK_AI_MMU_APB_EB>,
					<&ai_gate CLK_AI_CAMBRICON_EB>,
					<&ai_clk CLK_AI_MTX>,
					<&ai_clk CLK_CAMBRICON>,
					<&g12_pll CLK_TWPLL_512M>,
					<&g12_pll CLK_TWPLL_768M>,
					<&g12_pll CLK_APLL>;
			};
		};
